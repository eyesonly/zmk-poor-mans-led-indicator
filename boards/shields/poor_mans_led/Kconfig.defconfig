## boards/shields/poor_mans_led/Kconfig.defconfig
```kconfig
# Copyright (c) 2024 The ZMK Contributors
# SPDX-License-Identifier: MIT

if SHIELD_POOR_MANS_LED

config INDICATOR_LED_WIDGET
    default y

endif # SHIELD_POOR_MANS_LED
```

## boards/shields/poor_mans_led/Kconfig.shield
```kconfig
# Copyright (c) 2024 The ZMK Contributors
# SPDX-License-Identifier: MIT

config SHIELD_POOR_MANS_LED
    def_bool $(shields_list_contains,poor_mans_led)
```
